## UploadScanner_littlespidy/src/main/resources/samples/allowed-extensions/web-data/sample.yaml
```yaml
sample: allowed_extension
extension: yaml
description: Upload Scanner Allowed Extension Sample
```
